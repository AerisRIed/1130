# illegal_registers: IP-XACT component
VLNV cadence:cdns_lib:illegal_registers:1685-2009

## Address spaces and blocks
sd3101_t4_registers.sd3101_phy_registers: base 0x00000, range 0x3ffff, width 32

## Registers
Registers are 32-bit, read-write, reset 0x0 unless marked. A register's access mark holds for its fields unless they carry their own. Offsets are from the block's base; lines under a group give offsets from that group; [hi:lo] are bit positions; {n}, {i} and the like mark numbered series; 'fields as' and 'values as' point back to an identical list; <NAME> marks a mode.

## sd3101_t4_registers.sd3101_phy_registers
Base 0x00000000
0xFFFC cmn_illegal_reg — Common illegal register
  [31:0] cmn_illegal_reg_31_0 ro — Reserved
0x107FC pma_tx_illegal_reg — PMA TX illegal register
  [31:0] pma_tx_illegal_reg_31_0 ro — Reserved
0x207FC pma_rx_illegal_reg — PMA RX illegal register
  [31:0] pma_rx_illegal_reg_31_0 ro — Reserved
0x33FFC phy_pcs_cmn_illegal_reg — PHY PCS CMN illegal register
  [31:0] phy_pcs_cmn_illegal_reg_31_0 ro — Reserved
0x37FFC phy_pcs_lane_illegal_reg — PHY PCS LANE illegal register
  [31:0] phy_pcs_lane_illegal_reg_31_0 ro — Reserved
0x3BFFC phy_pma_cmn_illegal_reg — PHY PMA CMN illegal register
  [31:0] phy_pma_cmn_illegal_reg_31_0 ro — Reserved
0x3FFFC phy_pma_lane_illegal_reg — PHY PMA LANE illegal register
  [31:0] phy_pma_lane_illegal_reg_31_0 ro — Reserved
